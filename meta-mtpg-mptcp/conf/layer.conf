## meta-mtpg-mptcp/conf/layer.conf
```bitbake
# We have a conf and classes directory, add to BBPATH
BBPATH .= ":${LAYERDIR}"

# We have recipes-* directories, add to BBFILES
BBFILES += "${LAYERDIR}/recipes-*/*/*.bb \
	${LAYERDIR}/recipes-*/*/*.bbappend"

BBFILE_COLLECTIONS += "mptcp"
BBFILE_PATTERN_mptcp = "^${LAYERDIR}/"
BBFILE_PRIORITY_mptcp = "6"
```
